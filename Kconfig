## Kconfig
```kconfig
#
# Copyright (c) 2022 Laird Connectivity LLC
#
# SPDX-License-Identifier: LicenseRef-LairdConnectivity-Clause
#
menuconfig LCZ_LWM2M_CURRENT
	bool "Enable LwM2M Current Object"
	depends on LCZ_LWM2M_UTIL
	depends on LCZ_LWM2M_IPSO_CURRENT_SENSOR

if LCZ_LWM2M_CURRENT

module=LCZ_LWM2M_CURRENT
module-str=LWM2M_CURRENT
source "subsys/logging/Kconfig.template.log_config"

endif # LCZ_LWM2M_CURRENT
```
